## kernel/core/servecosys_defconfig
```kconfig
#
# ServEcosys Kernel Configuration
# 最小化内核配置 - 基于 Linux 6.6 LTS
#
# 设计原则：
# - 仅保留核心功能（进程调度、内存管理、网络协议栈、安全钩子）
# - 设备驱动全部模块化（可插拔）
# - SELinux 强制开启，不可运行时降级
# - Btrfs 文件系统支持（原子快照）
#
# 核心职责（内置）：
#   ✓ 进程调度（CFS + RT）
#   ✓ 内存管理（分页/虚拟内存/THP）
#   ✓ 网络协议栈（IPv4/IPv6/TCP/UDP）
#   ✓ 核心安全钩子（LSM/SELinux）
#
# 设备驱动（模块）：
#   → PCIe/USB/GPU/网络/音频 → kernel/modules/pc/
#   → SoC/触控/传感器/电源 → kernel/modules/mobile/
#   → 硬件指纹探测 → kernel/modules/probe/
#

# 基本配置
CONFIG_64BIT=y
CONFIG_X86_64=y
CONFIG_X86=y
CONFIG_LOCKDEP_SUPPORT=y
CONFIG_STACKTRACE_SUPPORT=y
CONFIG_ILLEGAL_POINTER_VALUE=0xdead000000000000

# 内核版本信息
CONFIG_LOCALVERSION="-servecosys"
CONFIG_LOCALVERSION_AUTO=y

# 编译选项
CONFIG_CC_OPTIMIZE_FOR_PERFORMANCE=y
# CONFIG_CC_OPTIMIZE_FOR_SIZE is not set
CONFIG_LTO_NONE=y
CONFIG_LD_DEAD_CODE_DATA_ELIMINATION=y

# ============================================================================
# 核心子系统（必需）
# ============================================================================

# 进程调度
CONFIG_SCHED_MC=y
CONFIG_SCHED_SMT=y
CONFIG_NUMA=y
CONFIG_HZ_1000=y
CONFIG_PREEMPT_VOLUNTARY=y

# 内存管理
CONFIG_SPARSEMEM=y
CONFIG_SPARSEMEM_VMEMMAP=y
CONFIG_TRANSPARENT_HUGEPAGE=y
CONFIG_KSM=y
CONFIG_CGROUPS=y
CONFIG_CGROUP_SCHED=y
CONFIG_CGROUP_FREEZER=y
CONFIG_CGROUP_DEVICE=y
CONFIG_CGROUP_CPUACCT=y

# 虚拟内存
CONFIG_VMAP_STACK=y
CONFIG_DEBUG_VM=y

# ============================================================================
# 安全子系统（ServEcosys 核心）
# ============================================================================

# SELinux - 强制开启
CONFIG_SECURITY=y
CONFIG_SECURITY_SELINUX=y
CONFIG_SECURITY_SELINUX_BOOTPARAM=y
CONFIG_SECURITY_SELINUX_DISABLE=y
CONFIG_SECURITY_SELINUX_DEVELOP=y
CONFIG_SECURITY_SELINUX_AVC_STATS=y
CONFIG_DEFAULT_SECURITY_SELINUX=y
CONFIG_DEFAULT_SECURITY="selinux"

# LSM 钩子
CONFIG_SECURITYFS=y
CONFIG_SECURITY_NETWORK=y
CONFIG_SECURITY_PATH=y
CONFIG_HAVE_HARDENED_USERCOPY_ALLOCATOR=y
CONFIG_HARDENED_USERCOPY=y
CONFIG_HARDENED_USERCOPY_FALLBACK=y
CONFIG_HARDENED_USERCOPY_PAGESPAN=n

# 其他安全特性
CONFIG_INIT_STACK_ALL_ZERO=y
CONFIG_INIT_ON_ALLOC_DEFAULT_ON=y
CONFIG_STATIC_USERMODEHELPER=y
CONFIG_MODULE_SIG=y
CONFIG_MODULE_SIG_FORCE=y
CONFIG_MODULE_SIG_SHA256=y

# ============================================================================
# 文件系统
# ============================================================================

# Btrfs - 原子快照支持
CONFIG_BTRFS_FS=y
CONFIG_BTRFS_FS_POSIX_ACL=y
CONFIG_BTRFS_FS_CHECK_INTEGRITY=y

# 其他必需文件系统
CONFIG_EXT4_FS=y
CONFIG_EXT4_FS_POSIX_ACL=y
CONFIG_TMPFS=y
CONFIG_TMPFS_POSIX_ACL=y

# 伪文件系统
CONFIG_PROC_FS=y
CONFIG_SYSFS=y
CONFIG_DEVPTS_FS=y
CONFIG_DEVKMEM=n

# ============================================================================
# 网络协议栈（最小化）
# ============================================================================

CONFIG_NET=y
CONFIG_INET=y
CONFIG_IP_MULTICAST=y
CONFIG_IP_ADVANCED_ROUTER=y
CONFIG_INET_AH=y
CONFIG_INET_ESP=y
CONFIG_INET_IPCOMP=y
CONFIG_INET_XFRM_MODE_TRANSPORT=y
CONFIG_INET_XFRM_MODE_TUNNEL=y
CONFIG_INET_XFRM_MODE_BEET=y
CONFIG_INET_DIAG=y
CONFIG_INET_DIAG_DESTROY=y
CONFIG_TCP_CONG_CUBIC=y
CONFIG_DEFAULT_TCP_CONG="cubic"

# IPv6
CONFIG_IPV6=y
CONFIG_IPV6_PRIVACY=y
CONFIG_IPV6_ROUTER_PREF=y
CONFIG_IPV6_ROUTE_INFO=y
CONFIG_INET6_AH=y
CONFIG_INET6_ESP=y
CONFIG_INET6_IPCOMP=y
CONFIG_IPV6_MIP6=y

# 网络过滤
CONFIG_NETFILTER=y
CONFIG_NETFILTER_ADVANCED=y
CONFIG_BRIDGE_NETFILTER=y

# ============================================================================
# 设备驱动支持（全部模块化 - 可插拔）
# ============================================================================
# 注意：设备驱动不内置到内核，全部编译为独立模块
# 模块位置：kernel/modules/pc/, kernel/modules/mobile/, kernel/modules/probe/

# PCI 总线支持（模块）
CONFIG_PCI=y
CONFIG_PCI_DIRECT=y
CONFIG_PCI_MMCONFIG=y
CONFIG_PCIEPORTBUS=y
CONFIG_PCIEAER=y

# USB 子系统（模块）
CONFIG_USB=y
CONFIG_USB_XHCI_HCD=m
CONFIG_USB_EHCI_HCD=m
CONFIG_USB_OHCI_HCD=m
CONFIG_USB_UHCI_HCD=m
CONFIG_USB_STORAGE=m
CONFIG_USB_SERIAL=m

# 显卡驱动（模块 - 不包含在核心中）
CONFIG_DRM=m
CONFIG_DRM_I915=m
CONFIG_DRM_AMDGPU=m
CONFIG_DRM_NOUVEAU=m

# 网络驱动（模块 - 不包含在核心中）
CONFIG_NETDEVICES=y
CONFIG_E1000E=m
CONFIG_IGB=m
CONFIG_R8169=m
CONFIG_IWLWIFI=m
CONFIG_IWLMVM=m

# 存储控制器（模块）
CONFIG_SATA_AHCI=m
CONFIG_NVME_CORE=m
CONFIG_BLK_DEV_NVME=m

# ============================================================================
# 内核模块支持
# ============================================================================

CONFIG_MODULES=y
CONFIG_MODULE_UNLOAD=y
CONFIG_MODVERSIONS=y
CONFIG_MODULE_SRCVERSION_ALL=y
CONFIG_KALLSYMS=y
CONFIG_KALLSYMS_ALL=y

# ServEcosys 自定义模块
CONFIG_SERVECOSYS_CORE=y
CONFIG_SERVECOSYS_PROBE=m
CONFIG_SERVECOSYS_PC_MODULES=m
CONFIG_SERVECOSYS_MOBILE_MODULES=m

# ============================================================================
# 启动选项
# ============================================================================

CONFIG_BLK_DEV_INITRD=y
CONFIG_INITRAMFS_SOURCE=""
CONFIG_RD_GZIP=y
CONFIG_RD_BZIP2=y
CONFIG_RD_LZMA=y
CONFIG_RD_XZ=y
CONFIG_RD_LZO=y
CONFIG_RD_LZ4=y

# 控制台
CONFIG_SERIAL_8250=y
CONFIG_SERIAL_8250_CONSOLE=y
CONFIG_PRINTK=y
CONFIG_CONSOLE_LOGLEVEL_DEFAULT=7
CONFIG_CONSOLE_LOGLEVEL_QUIET=4

# ACPI
CONFIG_ACPI=y
CONFIG_ACPI_SLEEP=y
CONFIG_PM=y
CONFIG_PM_SLEEP=y
CONFIG_SUSPEND=y
CONFIG_HIBERNATE_CALLBACKS=y

# ============================================================================
# 调试选项（可选）
# ============================================================================

# CONFIG_DEBUG_KERNEL is not set
# CONFIG_DEBUG_INFO is not set
CONFIG_DEBUG_BUGVERBOSE=y
CONFIG_PANIC_ON_OOPS=y
CONFIG_PANIC_TIMEOUT=5

# ============================================================================
# 架构特定选项
# ============================================================================

CONFIG_X86_FEATURE_NAMES=y
CONFIG_X86_MCE=y
CONFIG_X86_MCE_INTEL=y
CONFIG_X86_MCE_AMD=y
CONFIG_MICROCODE=y
CONFIG_MICROCODE_INTEL=y
CONFIG_MICROCODE_AMD=y
CONFIG_RETPOLINE=y
CONFIG_X86_INTEL_PSTATE=y
CONFIG_X86_AMD_PSTATE=m

# ============================================================================
# 移除不必要的功能
# ============================================================================

# 不需要的文件系统
# CONFIG_MINIX_FS is not set
# CONFIG_FAT_FS is not set
# CONFIG_NTFS_FS is not set
# CONFIG_EXFAT_FS is not set

# 不需要的网络协议
# CONFIG_ATM is not set
# CONFIG_LLC2 is not set
# CONFIG_IPX is not set
# CONFIG_ATALK is not set
# CONFIG_X25 is not set
# CONFIG_LAPB is not set
# CONFIG_PHONET is not set
# CONFIG_6LOWPAN is not set
# CONFIG_IEEE802154 is not set

# 不需要的硬件支持
# CONFIG_PARPORT is not set
# CONFIG_PNP is not set
# CONFIG_PCMCIA is not set
# CONFIG_ISA is not set
# CONFIG_MCA is not set
# CONFIG_EISA is not set
# CONFIG_VLB is not set
# CONFIG_HOTPLUG_PCI is not set

# ============================================================================
# ServEcosys 特定配置
# ============================================================================

# 硬件指纹支持
CONFIG_SERVECOSYS_FINGERPRINT=y
CONFIG_SERVECOSYS_FINGERPRINT_SIZE=32

# 双域隔离
CONFIG_SERVECOSYS_DUAL_DOMAIN=y
CONFIG_SERVECOSYS SED_DOMAIN=y
CONFIG_SERVECOSYS_UID_DOMAIN=y

# 权限阶梯
CONFIG_SERVECOSYS_PERMISSION_LEVELS=12

# OIPES 客户端
CONFIG_SERVECOSYS_OIPES=m

# Btrfs 快照恢复
CONFIG_SERVECOSYS_SNAPSHOT_RECOVERY=y
CONFIG_SERVECOSYS_SNAPSHOT_MAX=10

# ============================================================================
# 内核版本
# ============================================================================

CONFIG_LINUX_VERSION_CODE=393728
CONFIG_EXTRAVERSION=".0"
```
