## root project/kernel/core/Kconfig
```kconfig
#
# ServEcosys Kernel Core - 内核中央 Kconfig
#
# 内核中央只包含内核最基础的功能，每个基础功能是一个原子。
# 通过 source 进内核源码树的 Kconfig 树（例如 init/Kconfig 或
# arch/Kconfig 的 source "kernel/core/Kconfig"）。
#
# 用法（补丁由 scripts/apply_kernel_patch.sh 注入）：
#   source "kernel/core/Kconfig"
#

config SERVECOSYS_CORE
	bool "ServEcosys Kernel Core - 内核中央"
	help
	  ServEcosys 内核中央：只包含内核最基础的功能（进程调度、
	  内存管理、网络协议栈），以原子形式提供，由 main.c 统一编排。

if SERVECOSYS_CORE

config SERVECOSYS_CORE_SCHED
	bool "原子: 进程调度"
	depends on SCHED_CFS
	default y
	help
	  进程调度原子（CFS + RT），纳入内核中央初始化序列。

config SERVECOSYS_CORE_MM
	bool "原子: 内存管理"
	default y
	help
	  内存管理原子（分页/THP/KSM），纳入内核中央初始化序列。

config SERVECOSYS_CORE_NET
	bool "原子: 网络协议栈"
	depends on INET
	default y
	help
	  网络协议栈原子（IPv4/IPv6 双栈），纳入内核中央初始化序列。

endif # SERVECOSYS_CORE
```

## root project/kernel/modules/Kconfig
```kconfig
#
# ServEcosys 内核模块 - Kconfig 总入口
#
# 由 scripts/apply_kernel_patch.sh 挂接进内核源码树的 Kconfig 链。
# 各模块集以独立 Kconfig 定义，构建时按 CONFIG_* 决定编译与否。
#

menu "ServEcosys Kernel Modules"

source "kernel/servecosys/modules/guard/Kconfig"
source "kernel/servecosys/modules/probe/Kconfig"
source "kernel/servecosys/modules/pc/Kconfig"
source "kernel/servecosys/modules/mobile/Kconfig"

endmenu
```

## root project/kernel/modules/guard/Kconfig
```kconfig
#
# ServEcosys Guard - 0day 检测与拦截内核模块
#

config SERVECOSYS_GUARD
	tristate "ServEcosys 0day 检测与拦截模块"
	depends on SECURITY
	default m
	help
	  ServEcosys 0day 防护：基于"违背最小特权 + 违背内核完整性"
	  行为指纹，检测并拦截典型的权限提升与内核破坏利用。
	  （cred 突变检测 / rodata 哨兵 CRC / Oops 风暴看门狗）
```

## root project/kernel/modules/mobile/Kconfig
```kconfig
#
# ServEcosys 移动设备适配模块集
#

config SERVECOSYS_MOBILE_MODULES
	tristate "ServEcosys 移动设备适配模块集"
	depends on PCI || (ARM && ARM64)
	default m
	help
	  ServEcosys 移动设备适配：SoC/触控/传感器/电源/蜂窝网络等支持。
	  作为可插拔模块集，按需加载。
```

## root project/kernel/modules/pc/Kconfig
```kconfig
#
# ServEcosys PC 设备适配模块集
#

config SERVECOSYS_PC_MODULES
	tristate "ServEcosys PC 设备适配模块集"
	depends on PCI
	default m
	help
	  ServEcosys PC 设备适配：PCIe/USB/GPU/网络/音频等 PC 硬件支持。
	  作为可插拔模块集，按需加载。
```

## root project/kernel/modules/probe/Kconfig
```kconfig
#
# ServEcosys 硬件指纹探测模块
#

config SERVECOSYS_PROBE
	tristate "ServEcosys 硬件指纹探测模块"
	depends on DMI || PCI
	default m
	help
	  ServEcosys 硬件指纹探测：采集 CPU/芯片组/PCIe/存储等硬件信息，
	  生成 SHA256 硬件指纹，供快速启动与硬件变更检测使用。
```
